## main/Kconfig.projbuild
```kconfig
menu "**[ SolarEdge setup ]**"
  config SOLAREDGE_USE_LCD
    bool "Enable to use lvgl on ESP32-8048S043"
    default y if IDF_TARGET_ESP32S3
    depends on IDF_TARGET_ESP32S3
    help
      When selected, code will be added to display realtime measurements using a ESP32-8048S043
endmenu
```

## sdkconfig.defaults
```kconfig
CONFIG_PARTITION_TABLE_CUSTOM=y
CONFIG_HTTPD_WS_SUPPORT=y
CONFIG_LWIP_DHCP_GET_NTP_SRV=y
```
